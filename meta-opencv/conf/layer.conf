## meta-opencv/conf/layer.conf
```bitbake
# We have a conf and classes directory, add to BBPATH
BBPATH .= ":${LAYERDIR}"

# We have recipes-* directories, add to BBFILES
BBFILES += "${LAYERDIR}/recipes-*/*/*.bb \
            ${LAYERDIR}/recipes-*/*/*.bbappend"

BBFILE_COLLECTIONS += "meta-opencv"
BBFILE_PATTERN_meta-opencv = "^${LAYERDIR}/"
BBFILE_PRIORITY_meta-opencv = "6"

LAYERDEPENDS_meta-opencv = "core"
LAYERSERIES_COMPAT_meta-opencv = "kirkstone"
```
